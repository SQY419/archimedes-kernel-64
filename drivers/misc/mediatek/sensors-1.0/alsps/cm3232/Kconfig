## drivers/misc/mediatek/sensors-1.0/alsps/cm3232/Kconfig
```kconfig
config MTK_CM3232
	bool "CM3232 for MediaTek ALSPS"
	default n
	help
	  Enable the Capella CM3232 ambient-light sensor through the
	  MediaTek ALSPS framework.
```
